## configs/nanopi2_defconfig
```kconfig
BR2_arm=y
BR2_cortex_a9=y
BR2_ARM_EABIHF=y
BR2_ARM_ENABLE_NEON=y
BR2_ARM_FPU_NEON=y
BR2_KERNEL_HEADERS_3_4=y
BR2_TOOLCHAIN_BUILDROOT_GLIBC=y
BR2_TOOLCHAIN_BUILDROOT_CXX=y
BR2_TARGET_GENERIC_PASSWD_SHA256=y
BR2_ROOTFS_DEVICE_CREATION_DYNAMIC_MDEV=y
BR2_ROOTFS_POST_BUILD_SCRIPT="$(BR2_EXTERNAL)/scripts/post_build.sh"
BR2_ROOTFS_POST_SCRIPT_ARGS="nanopi2"
BR2_LINUX_KERNEL=y
BR2_LINUX_KERNEL_CUSTOM_GIT=y
BR2_LINUX_KERNEL_CUSTOM_REPO_URL="https://github.com/friendlyarm/linux-3.4.y"
BR2_LINUX_KERNEL_CUSTOM_REPO_VERSION="s5p4418-nanopi2"
BR2_LINUX_KERNEL_DEFCONFIG="nanopi2_linux"
BR2_PACKAGE_BUSYBOX_CONFIG="${BR2_EXTERNAL}/configs/busybox.config"
BR2_PACKAGE_LMBENCH=y
BR2_PACKAGE_STRESS_NG=y
BR2_PACKAGE_I2C_TOOLS=y
BR2_PACKAGE_PYTHON=y
BR2_PACKAGE_PYTHON_SERIAL=y
BR2_PACKAGE_PYTHON_SPIDEV=y
BR2_PACKAGE_TSLIB=y
BR2_PACKAGE_LIBDAEMON=y
BR2_PACKAGE_IW=y
BR2_PACKAGE_OPENSSH=y
BR2_PACKAGE_WPA_SUPPLICANT=y
BR2_PACKAGE_WPA_SUPPLICANT_PASSPHRASE=y
BR2_TARGET_ROOTFS_TAR_GZIP=y
BR2_TARGET_UBOOT=y
BR2_TARGET_UBOOT_BOARDNAME="s5p4418_nanopi2"
BR2_TARGET_UBOOT_CUSTOM_GIT=y
BR2_TARGET_UBOOT_CUSTOM_REPO_URL="https://github.com/friendlyarm/uboot_nanopi2.git"
BR2_TARGET_UBOOT_CUSTOM_REPO_VERSION="s5p4418-nanopi2"
BR2_PACKAGE_BROADCOM_BLUETOOTH=y
```

## configs/nanopi_defconfig
```kconfig
BR2_arm=y
BR2_TOOLCHAIN_BUILDROOT_GLIBC=y
BR2_GCC_VERSION_4_8_X=y
BR2_TOOLCHAIN_BUILDROOT_CXX=y
BR2_TARGET_GENERIC_PASSWD_SHA256=y
BR2_ROOTFS_DEVICE_CREATION_DYNAMIC_MDEV=y
BR2_ROOTFS_POST_BUILD_SCRIPT="$(BR2_EXTERNAL)/scripts/post_build.sh"
BR2_LINUX_KERNEL=y
BR2_LINUX_KERNEL_CUSTOM_GIT=y
BR2_LINUX_KERNEL_CUSTOM_REPO_URL="https://github.com/ARMWorks/NanoPi-Linux-4.1.y"
BR2_LINUX_KERNEL_CUSTOM_REPO_VERSION="master"
BR2_LINUX_KERNEL_PATCH="$(BR2_EXTERNAL)/patches/kernel_fixes.patch"
BR2_LINUX_KERNEL_DEFCONFIG="nanopi"
BR2_LINUX_KERNEL_ZIMAGE=y
BR2_PACKAGE_I2C_TOOLS=y
BR2_PACKAGE_PYTHON=y
BR2_PACKAGE_PYTHON_SERIAL=y
BR2_PACKAGE_PYTHON_SPIDEV=y
BR2_PACKAGE_TSLIB=y
BR2_PACKAGE_AVAHI=y
BR2_PACKAGE_AVAHI_DAEMON=y
BR2_PACKAGE_AVAHI_LIBDNSSD_COMPATIBILITY=y
BR2_PACKAGE_IW=y
BR2_PACKAGE_OPENSSH=y
BR2_PACKAGE_WPA_SUPPLICANT=y
BR2_PACKAGE_WPA_SUPPLICANT_PASSPHRASE=y
BR2_TARGET_ROOTFS_TAR_GZIP=y
BR2_TARGET_UBOOT=y
BR2_TARGET_UBOOT_BOARDNAME="nanopi"
BR2_TARGET_UBOOT_CUSTOM_GIT=y
BR2_TARGET_UBOOT_CUSTOM_REPO_URL="https://github.com/friendlyarm/uboot_nanopi.git"
BR2_TARGET_UBOOT_CUSTOM_REPO_VERSION="nanopi"
BR2_PACKAGE_BROADCOM_BLUETOOTH=y
BR2_PACKAGE_FGPIO=y
```

## configs/nanopi_gui_defconfig
```kconfig
BR2_arm=y
BR2_KERNEL_HEADERS_4_1=y
BR2_TOOLCHAIN_BUILDROOT_GLIBC=y
BR2_GCC_VERSION_4_8_X=y
BR2_TOOLCHAIN_BUILDROOT_CXX=y
BR2_TARGET_GENERIC_PASSWD_SHA256=y
BR2_ROOTFS_DEVICE_CREATION_DYNAMIC_MDEV=y
BR2_ROOTFS_POST_BUILD_SCRIPT="$(BR2_EXTERNAL)/scripts/post_build.sh"
BR2_ROOTFS_POST_SCRIPT_ARGS="nanopi"
BR2_LINUX_KERNEL=y
BR2_LINUX_KERNEL_CUSTOM_GIT=y
BR2_LINUX_KERNEL_CUSTOM_REPO_URL="https://github.com/ARMWorks/NanoPi-Linux-4.1.y"
BR2_LINUX_KERNEL_CUSTOM_REPO_VERSION="master"
BR2_LINUX_KERNEL_PATCH="$(BR2_EXTERNAL)/patches/nanopi_kernel_fixes.patch"
BR2_LINUX_KERNEL_DEFCONFIG="nanopi"
BR2_LINUX_KERNEL_ZIMAGE=y
BR2_PACKAGE_BUSYBOX_CONFIG="$(BR2_EXTERNAL)/configs/busybox.config"
BR2_PACKAGE_QT_LICENSE_APPROVED=y
# BR2_PACKAGE_QT_PIXEL_DEPTH_32 is not set
BR2_PACKAGE_QT_FONT_UNIFONT=y
BR2_PACKAGE_QT_GIF=y
BR2_PACKAGE_QT_SYSTEMJPEG=y
BR2_PACKAGE_QT_SYSTEMPNG=y
BR2_PACKAGE_QT_GFX_TRANSFORMED=y
BR2_PACKAGE_QT_MOUSE_TSLIB=y
BR2_PACKAGE_EVTEST=y
BR2_PACKAGE_I2C_TOOLS=y
BR2_PACKAGE_PYTHON=y
BR2_PACKAGE_PYTHON_PYQT=y
BR2_PACKAGE_PYTHON_SERIAL=y
BR2_PACKAGE_PYTHON_SPIDEV=y
BR2_PACKAGE_LIBGCRYPT=y
BR2_PACKAGE_LIBRTLSDR=y
BR2_PACKAGE_TSLIB=y
BR2_PACKAGE_NCURSES=y
BR2_PACKAGE_NCURSES_WCHAR=y
BR2_PACKAGE_NCURSES_TARGET_PANEL=y
BR2_PACKAGE_NCURSES_TARGET_FORM=y
BR2_PACKAGE_NCURSES_TARGET_MENU=y
BR2_PACKAGE_NCURSES_TARGET_PROGS=y
BR2_PACKAGE_AVAHI=y
BR2_PACKAGE_AVAHI_DAEMON=y
BR2_PACKAGE_AVAHI_LIBDNSSD_COMPATIBILITY=y
BR2_PACKAGE_IW=y
BR2_PACKAGE_OPENSSH=y
BR2_PACKAGE_WIRELESS_TOOLS=y
BR2_PACKAGE_WIRELESS_TOOLS_LIB=y
BR2_PACKAGE_WPA_SUPPLICANT=y
BR2_PACKAGE_WPA_SUPPLICANT_PASSPHRASE=y
BR2_TARGET_ROOTFS_TAR_GZIP=y
BR2_TARGET_UBOOT=y
BR2_TARGET_UBOOT_BOARDNAME="nanopi"
BR2_TARGET_UBOOT_CUSTOM_GIT=y
BR2_TARGET_UBOOT_CUSTOM_REPO_URL="https://github.com/friendlyarm/uboot_nanopi.git"
BR2_TARGET_UBOOT_CUSTOM_REPO_VERSION="nanopi"
BR2_PACKAGE_BROADCOM_BLUETOOTH=y
BR2_PACKAGE_FGPIO=y
BR2_PACKAGE_QAPPLAUNCHER=y
BR2_PACKAGE_FGPIO_DEMO=y
```

## package/Config.in
```kconfig
menu "Packages"
source "$BR2_EXTERNAL/package/broadcom-bluetooth/Config.in"
source "$BR2_EXTERNAL/package/fgpio/Config.in"
source "$BR2_EXTERNAL/package/qapplauncher/Config.in"
source "$BR2_EXTERNAL/package/fgpio_demo/Config.in"
endmenu
```

## package/broadcom-bluetooth/Config.in
```kconfig
if BR2_INIT_SYSV || BR2_INIT_BUSYBOX
config BR2_PACKAGE_BROADCOM_BLUETOOTH
	bool "brcm_patchram_plus"
    select BR2_PACKAGE_BLUEZ5_UTILS

	help
      Broadcom utility for loading firmware to 
      Bluetooth devices.

	  https://code.google.com/p/broadcom-bluetooth/
endif

if !BR2_INIT_SYSV && !BR2_INIT_BUSYBOX
comment "brcm_patchram_plus Currently requires a SysV or Busybox init system."
	depends on !BR2_INIT_SYSV || !BR2_INIT_BUSYBOX
endif
```

## package/fgpio/Config.in
```kconfig
config BR2_PACKAGE_FGPIO
	bool "FriendlyARM Python GPIO"
	depends on BR2_PACKAGE_PYTHON
	help
	  Simple GPIO interface for FriendlyARM boards.

	  https://github.com/jrspruitt/FriendlyARM_Python_GPIO

comment "fgpio requires build w/ Python"
	depends on !BR2_PACKAGE_PYTHON
```

## package/fgpio_demo/Config.in
```kconfig
config BR2_PACKAGE_FGPIO_DEMO
	bool "PyQT GPIO Demo"
	depends on BR2_PACKAGE_PYTHON_PYQT && \
            BR2_PACKAGE_QAPPLAUNCHER
	help
	  Simple PyQT GPIO demonstration
	  https://github.com/jrspruitt/FGPIO_DEMO
```

## package/pyfa_gpio/Config.in
```kconfig
config BR2_PACKAGE_PYFA_GPIO
	bool "pyfa_gpio"
	depends on BR2_PACKAGE_PYTHON
	help
	  Simple GPIO interface for FriendlyARM boards.

	  https://github.com/jrspruitt/pyfa_gpio

comment "Requires Python"
	depends on BR2_PACKAGE_PYTHON
```

## package/qapplauncher/Config.in
```kconfig
menu "QAppLauncher"
config BR2_PACKAGE_QAPPLAUNCHER
	bool "QAppLauncher"
	depends on BR2_PACKAGE_QT && \
		(BR2_PACKAGE_QT_SYSTEMPNG || BR2_PACKAGE_QT_QTPNG) && \
		BR2_PACKAGE_QT_MOUSE_TSLIB
	help
	  QAppLauncher is a simple GUI
	  application launcher.
	  https://github.com/jrspruitt/QAppLauncher

if BR2_PACKAGE_QAPPLAUNCHER
choice
	prompt "LCD Size"
	config BR2_PACKAGE_QAPPLAUNCHER_LCD35
		bool "3.5 Inch"
	config BR2_PACKAGE_QAPPLAUNCHER_LCD43
		bool "4.3 Inch"
	config BR2_PACKAGE_QAPPLAUNCHER_LCD7
		bool "7 Inch"
endchoice
endif
endmenu
```
